## Kconfig
```kconfig
menu "GECL OTA Manager Configuration"

    config GECL_OTA_MANAGER_ENABLED
        bool "Enable OTA Manager"
        default y
        help
            Enable or disable the OTA Manager component.
    
    config GECL_OTA_TIMEOUT_MINUTES
        int "OTA Timeout (minutes)"
        default 15
        help
            Timeout in minutes for OTA operations.
endmenu
    
```
